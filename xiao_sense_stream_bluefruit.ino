/*
  XIAO nRF52840 Sense -> Web Bluetooth streamer (Bluefruit / SoftDevice)

  - IMU (LSM6DS3TR-C) accel + gyro @ 416 Hz, per-sample epoch timestamps
  - PDM microphone @ 20 kHz, 16-bit mono, streamed as IMA ADPCM (4:1)
  - Unix epoch time is pushed from the web page (the board has no RTC)

  Board package : "Seeed nRF52 Boards" (the Adafruit-based one)
                  -> board "Seeed XIAO nRF52840 Sense"
  Libraries     : Bluefruit and PDM come with the board package.
                  Seeed_Arduino_LSM6DS3 (Seeed's version) for the IMU.

  ---------------------------------------------------------------------------
  WHY THE OLD VERSION SOUNDED LIKE NOISE / BUZZ
  ---------------------------------------------------------------------------
  The nRF52840 PDM clock is generated by dividing HFCLK, and HFCLK has two
  possible sources: the internal 32 MHz RC oscillator (HFINT, ~2 % off) and
  the 32 MHz crystal (HFXO).  The SoftDevice switches between them around
  every radio event, so with a 7.5 ms connection interval the PDM clock
  changes source 133 times per second.

  Adafruit's PDMClass::begin() only calls sd_clock_hfclk_request() when
  sd_clock_hfclk_is_running() says the crystal is *not* running.  Because
  Bluefruit.begin() is called first, the crystal happens to be running at
  that moment, so no reference is taken and the SoftDevice is free to stop
  it again.  Nordic's own PDM chapter says: "It is recommended (but not
  mandatory) to use the Xtal as HFCLK source."

  The result is exactly what the captured WAV showed: 9 s of noise whose
  spectrum consists only of harmonics of 133.33 Hz (= 1 / 7.5 ms), i.e. a
  click at every BLE connection event, and no acoustic content at all.

  holdHfxo() below takes a permanent crystal reference before the PDM is
  started, so PDM_CLK stays on the crystal and the radio no longer touches
  it.  Keep that call before PDM.begin().

  ---------------------------------------------------------------------------
  WIRE FORMAT  (identical to the previous version, so old recordings decode)
  ---------------------------------------------------------------------------
    [0]      type  1 = IMU, 2 = raw mic PCM, 3 = info/status, 4 = ADPCM mic
    [1..2]   seq u16, little endian (gaps = lost packets)
    [3..10]  t0 u64, epoch microseconds of the first sample
    [11]     n (meaning depends on type)

    IMU (type 1), n = sample count, 14 bytes per sample:
        dt u16 (16 us units since t0), gx gy gz ax ay az (int16)
        gyro +-500 dps (LSB = 500/32768), accel +-4 g (LSB = 4/32768)

    MIC raw PCM (type 2), n = samples, then n * int16 at MIC_HZ
    MIC ADPCM   (type 4), n = ADPCM data bytes (456 samples per 228 bytes)
        [12..13] pred i16, [14] step index u8, [15] reserved, then n bytes
        Every packet carries its own decoder state, so a lost packet only
        costs that packet.

    INFO  (type 3, n = 10): t0 field holds the mic sample rate in Hz
    INFO  (type 3, n = 11): t0 field holds (adpcm << 32) | mic sample rate
    STATUS(type 3, n = 1): mic failed to start   -> IMU only
    STATUS(type 3, n = 2): IMU not found         -> mic only
    STATUS(type 3, n = 3): BLE MTU too small for 244-byte packets

  Control characteristic (write):
    0x01                 start
    0x02                 stop
    0x03 + u64 epoch_us  set the wall clock
*/

#include <bluefruit.h>
#include <PDM.h>
#include <Wire.h>
#include <LSM6DS3.h>
#include <nrf_soc.h>          // sd_clock_hfclk_request()

// --------------------------------------------------------------------------
// configuration
// --------------------------------------------------------------------------
#define IMU_ADDR        0x6A
#define MIC_HZ          20000   // 20 kHz: PDM_CLK 1.28 MHz / ratio 64
#define MIC_GAIN        70      // 0..80, 40 = 0 dB, so 70 = +15 dB, 80 = +20 dB
#define IMU_PER_PKT     16

#define MIC_ADPCM       1       // 1 = 4-bit IMA ADPCM (~10 kB/s), 0 = 16-bit PCM (~40 kB/s)
#if MIC_ADPCM
  #define MIC_PER_PKT   456     // 228 bytes of ADPCM
#else
  #define MIC_PER_PKT   116     // 232 bytes of PCM
#endif

#define HDR             12
#define MIC_RING        16384   // power of two, 0.82 s at 20 kHz
#define IMU_RING        512     // power of two
#define PDM_BUF_BYTES   512     // bytes; 256 samples = 12.8 ms at 20 kHz

#define BLE_MTU         247
#define CONN_INTERVAL   12      // 12 * 1.25 ms = 15 ms
#define CONN_EVENT_LEN  12      // 12 * 1.25 ms, must not exceed the interval
#define DBG_WATCHDOG    1       // reset the board if loop() hangs for 8 s

// --------------------------------------------------------------------------
// BLE
// --------------------------------------------------------------------------
BLEService        svc(BLEUuid("19b10000-e8f2-537e-4f6c-d104768a1214"));
BLECharacteristic dataChr(BLEUuid("19b10001-e8f2-537e-4f6c-d104768a1214"));
BLECharacteristic ctrlChr(BLEUuid("19b10002-e8f2-537e-4f6c-d104768a1214"));

LSM6DS3  imu(I2C_MODE, IMU_ADDR);
TwoWire* imuWire = &Wire1;
bool     imuOk   = false;

volatile uint16_t connHdl    = BLE_CONN_HANDLE_INVALID;
volatile uint8_t  pendingCmd = 0;        // 0 none, 1 start, 2 stop
volatile bool     pendingTime = false;
volatile uint64_t pendingEpoch = 0;
volatile uint32_t pendingRaw = 0;

// --------------------------------------------------------------------------
// microsecond clock: free-running 1 MHz hardware timer, 64-bit extended
// --------------------------------------------------------------------------
static uint32_t mLast = 0, mHi = 0;

void clockStart() {
  NRF_TIMER4->MODE      = TIMER_MODE_MODE_Timer;
  NRF_TIMER4->BITMODE   = TIMER_BITMODE_BITMODE_32Bit;
  NRF_TIMER4->PRESCALER = 4;              // 16 MHz / 2^4 = 1 MHz
  NRF_TIMER4->TASKS_CLEAR = 1;
  NRF_TIMER4->TASKS_START = 1;
}

// Only call this from task context (loop / FreeRTOS task), never from an ISR.
uint64_t micros64() {
  uint32_t m, hi;
  taskENTER_CRITICAL();
  NRF_TIMER4->TASKS_CAPTURE[0] = 1;
  m = NRF_TIMER4->CC[0];
  if (m < mLast) mHi++;
  mLast = m;
  hi = mHi;
  taskEXIT_CRITICAL();
  return ((uint64_t)hi << 32) | m;
}

uint64_t epochBase = 0, baseMicros = 0;
uint64_t epochUs() { return epochBase + (micros64() - baseMicros); }

// --------------------------------------------------------------------------
// state
// --------------------------------------------------------------------------
volatile bool recording = false;
uint16_t seq = 0;
uint64_t recStartEpoch = 0;
uint32_t pktSent = 0, pktDropped = 0;

uint8_t  imuBuf[244];
uint8_t  imuN   = 0;
uint64_t imuT0  = 0;
struct ImuSample { uint64_t t; int16_t v[6]; };
ImuSample imuRing[IMU_RING];
volatile uint32_t imuWr = 0, imuRd = 0, imuDropped = 0;
volatile bool     imuSampling = false;

uint8_t  micBuf[244];
int16_t  micRing[MIC_RING];
volatile uint32_t micWr = 0, micRd = 0, micLost = 0;
volatile uint32_t micTotal = 0;          // samples captured since boot (rate check)
uint32_t micConsumed = 0;
bool     micOk = false;

volatile bool     micNeedBase = false;   // arm the timestamp anchor
volatile uint32_t micBaseRaw  = 0;       // TIMER4 value at the end of that buffer
volatile uint16_t micBaseN    = 0;       // samples in that buffer
bool     micBaseSet = false;

// --------------------------------------------------------------------------
// watchdog
// --------------------------------------------------------------------------
#if DBG_WATCHDOG
void wdtStart() {
  NRF_WDT->CONFIG = 0x01;                // keep running while the CPU sleeps
  NRF_WDT->CRV    = 8 * 32768UL;         // 8 s
  NRF_WDT->RREN   = 1;
  NRF_WDT->TASKS_START = 1;
}
inline void wdtKick() { NRF_WDT->RR[0] = 0x6E524635; }
#else
inline void wdtStart() {}
inline void wdtKick()   {}
#endif

// --------------------------------------------------------------------------
// BLE sending
// --------------------------------------------------------------------------
bool linkReady() {
  return connHdl != BLE_CONN_HANDLE_INVALID && dataChr.notifyEnabled(connHdl);
}

// notify() returns false when the SoftDevice queue is full.  Retry very
// briefly and then drop: blocking here stalls the mic ring for no good reason.
void sendPkt(uint8_t* b, uint16_t len) {
  if (!linkReady()) return;
  memcpy(b + 1, &seq, 2);
  seq++;                                 // consumed even when dropped
  for (int tries = 0; tries < 4; tries++) {
    if (dataChr.notify(connHdl, b, len)) { pktSent++; return; }
    if (!linkReady()) return;
    delay(1);
  }
  pktDropped++;
}

void sendInfo(uint8_t code, uint64_t value) {
  if (!linkReady()) return;
  uint8_t b[HDR] = {3, 0, 0, 0, 0, 0, 0, 0, 0, 0, 0, code};
  memcpy(b + 3, &value, 8);
  dataChr.notify(connHdl, b, HDR);
}

// --------------------------------------------------------------------------
// IMU
// --------------------------------------------------------------------------
void imuWrite(uint8_t reg, uint8_t v) {
  imuWire->beginTransmission(IMU_ADDR);
  imuWire->write(reg);
  imuWire->write(v);
  imuWire->endTransmission();
}

bool imuProbe() {
  imuWire->begin();
  imuWire->setClock(400000);
  delay(20);
  imuWire->beginTransmission(IMU_ADDR);
  imuWire->write(0x0F);                  // WHO_AM_I
  if (imuWire->endTransmission(false) != 0) return false;
  if (imuWire->requestFrom((uint8_t)IMU_ADDR, (uint8_t)1) != 1) return false;
  uint8_t id = imuWire->read();
  return id == 0x6A || id == 0x69;
}

bool imuInit() {
  imu.settings.gyroEnabled    = 1;
  imu.settings.gyroRange      = 500;
  imu.settings.gyroSampleRate = 416;
  imu.settings.accelEnabled    = 1;
  imu.settings.accelRange      = 4;
  imu.settings.accelSampleRate = 416;
  imu.begin();                           // powers the IMU; we probe ourselves
  delay(20);
  imuWire = &Wire1;
  if (!imuProbe()) {
    imuWire = &Wire;
    if (!imuProbe()) return false;
  }
  imuWrite(0x12, 0x44);                  // CTRL3_C: BDU + auto-increment
  imuWrite(0x10, 0x68);                  // CTRL1_XL: 416 Hz, +-4 g
  imuWrite(0x11, 0x64);                  // CTRL2_G : 416 Hz, 500 dps
  return true;
}

bool imuReady() {
  imuWire->beginTransmission(IMU_ADDR);
  imuWire->write(0x1E);                  // STATUS_REG
  if (imuWire->endTransmission(false) != 0) return false;
  if (imuWire->requestFrom((uint8_t)IMU_ADDR, (uint8_t)1) != 1) return false;
  return (imuWire->read() & 0x03) == 0x03;
}

bool imuReadOne() {
  if (!imuReady()) return false;
  imuWire->beginTransmission(IMU_ADDR);
  imuWire->write(0x22);                  // gyro XYZ then accel XYZ
  if (imuWire->endTransmission(false) != 0) return false;
  if (imuWire->requestFrom((uint8_t)IMU_ADDR, (uint8_t)12) != 12) return false;
  uint64_t t = epochUs();
  uint32_t w = imuWr;
  if (w - imuRd >= IMU_RING) {
    for (int i = 0; i < 12; i++) imuWire->read();
    imuDropped++;
    return true;
  }
  ImuSample& s = imuRing[w & (IMU_RING - 1)];
  s.t = t;
  uint8_t* b = (uint8_t*)s.v;
  for (int i = 0; i < 12; i++) b[i] = imuWire->read();
  imuWr = w + 1;
  return true;
}

void imuTask(void*) {                    // FreeRTOS task, above loop()
  for (;;) {
    if (!imuSampling) { delay(5); continue; }
    imuReadOne();
    delay(1);
  }
}

bool imuPoll() {
  bool sent = false;
  for (int guard = 0; guard < 48 && imuRd != imuWr; guard++) {
    uint32_t r = imuRd;
    ImuSample& s = imuRing[r & (IMU_RING - 1)];
    if (imuN == 0) imuT0 = s.t;
    uint8_t* p = imuBuf + HDR + imuN * 14;
    uint32_t d = (uint32_t)(s.t - imuT0) >> 4;
    if (d > 65535) d = 65535;
    uint16_t dt = (uint16_t)d;
    memcpy(p, &dt, 2);
    memcpy(p + 2, s.v, 12);
    imuRd = r + 1;
    if (++imuN == IMU_PER_PKT) {
      imuBuf[0] = 1;
      memcpy(imuBuf + 3, &imuT0, 8);
      imuBuf[11] = imuN;
      sendPkt(imuBuf, HDR + imuN * 14);
      imuN = 0;
      sent = true;
    }
  }
  return sent;
}

// --------------------------------------------------------------------------
// microphone
// --------------------------------------------------------------------------
void onPDM() {                           // PDM interrupt context
  static int16_t tmp[PDM_BUF_BYTES / 2];
  // The driver stops itself if a completed buffer is left unread, so drain
  // everything that is available (normally exactly one buffer).
  for (int guard = 0; guard < 4; guard++) {
    int n = PDM.available();
    if (n <= 0) break;
    if (n > (int)sizeof(tmp)) n = sizeof(tmp);
    int got = PDM.read(tmp, n);
    if (got <= 0) break;
    int cnt = got / 2;
    if (cnt <= 0) break;

    micTotal = micTotal + cnt;
    if (!recording) continue;

    if (micNeedBase) {
      NRF_TIMER4->TASKS_CAPTURE[1] = 1;  // 1 MHz timer, end of this buffer
      micBaseRaw = NRF_TIMER4->CC[1];
      micBaseN   = cnt;
      micNeedBase = false;
    }

    uint32_t w = micWr;
    for (int i = 0; i < cnt; i++) {
      if (w - micRd < MIC_RING) { micRing[w & (MIC_RING - 1)] = tmp[i]; w++; }
      else micLost = micLost + 1;
    }
    micWr = w;
  }
}

// Epoch time of mic sample 0 (ring index 0) from the anchor the IRQ captured.
void micSetBase() {
  if (micBaseSet || micNeedBase) return;
  if (micWr - micRd < MIC_PER_PKT) return;
  uint64_t now = micros64();
  uint32_t age = (uint32_t)now - micBaseRaw;
  uint64_t firstUs = now - age - (uint64_t)micBaseN * 1000000ULL / MIC_HZ;
  recStartEpoch = epochBase + (firstUs - baseMicros);
  micBaseSet = true;
}

#if MIC_ADPCM
// IMA ADPCM.  Each packet starts with the encoder state, so the page can
// decode every packet on its own even when one is lost.
static const int8_t adIdxTab[16] = {-1, -1, -1, -1, 2, 4, 6, 8, -1, -1, -1, -1, 2, 4, 6, 8};
static const int16_t adStepTab[89] = {
  7, 8, 9, 10, 11, 12, 13, 14, 16, 17, 19, 21, 23, 25, 28, 31, 34, 37, 41, 45, 50, 55, 60, 66,
  73, 80, 88, 97, 107, 118, 130, 143, 157, 173, 190, 209, 230, 253, 279, 307, 337, 371, 408,
  449, 494, 544, 598, 658, 724, 796, 876, 963, 1060, 1166, 1282, 1411, 1552, 1707, 1878, 2066,
  2272, 2499, 2749, 3024, 3327, 3660, 4026, 4428, 4871, 5358, 5894, 6484, 7132, 7845, 8630,
  9493, 10442, 11487, 12635, 13899, 15289, 16818, 18500, 20350, 22385, 24623, 27086, 29794, 32767};
int16_t adPred = 0;
int8_t  adIdx  = 0;

uint8_t adpcmEncode(int16_t sample) {
  int step = adStepTab[adIdx];
  int diff = sample - adPred;
  uint8_t code = 0;
  if (diff < 0) { code = 8; diff = -diff; }
  int vpdiff = step >> 3;
  if (diff >= step) { code |= 4; diff -= step; vpdiff += step; }
  step >>= 1;
  if (diff >= step) { code |= 2; diff -= step; vpdiff += step; }
  step >>= 1;
  if (diff >= step) { code |= 1; vpdiff += step; }
  int p = adPred + ((code & 8) ? -vpdiff : vpdiff);
  if (p > 32767)  p = 32767;
  if (p < -32768) p = -32768;
  adPred = (int16_t)p;
  int ix = adIdx + adIdxTab[code];
  if (ix < 0)  ix = 0;
  if (ix > 88) ix = 88;
  adIdx = (int8_t)ix;
  return code;
}

bool micPoll() {
  bool sent = false;
  micSetBase();
  if (!micBaseSet) return false;
  for (int k = 0; k < 4 && (micWr - micRd) >= MIC_PER_PKT; k++) {
    uint32_t r = micRd;
    memcpy(micBuf + HDR, &adPred, 2);
    micBuf[HDR + 2] = (uint8_t)adIdx;
    micBuf[HDR + 3] = 0;
    uint8_t* d = micBuf + HDR + 4;
    for (int i = 0; i < MIC_PER_PKT; i += 2) {
      uint8_t lo = adpcmEncode(micRing[(r + i) & (MIC_RING - 1)]);
      uint8_t hi = adpcmEncode(micRing[(r + i + 1) & (MIC_RING - 1)]);
      *d++ = lo | (hi << 4);
    }
    micRd = r + MIC_PER_PKT;
    uint64_t t0 = recStartEpoch + (uint64_t)(micConsumed + micLost) * 1000000ULL / MIC_HZ;
    micConsumed += MIC_PER_PKT;
    micBuf[0] = 4;
    memcpy(micBuf + 3, &t0, 8);
    micBuf[11] = MIC_PER_PKT / 2;        // ADPCM data bytes
    sendPkt(micBuf, HDR + 4 + MIC_PER_PKT / 2);
    sent = true;
  }
  return sent;
}
#else
bool micPoll() {
  bool sent = false;
  micSetBase();
  if (!micBaseSet) return false;
  for (int k = 0; k < 4 && (micWr - micRd) >= MIC_PER_PKT; k++) {
    int16_t* d = (int16_t*)(micBuf + HDR);
    uint32_t r = micRd;
    for (int i = 0; i < MIC_PER_PKT; i++) d[i] = micRing[(r + i) & (MIC_RING - 1)];
    micRd = r + MIC_PER_PKT;
    uint64_t t0 = recStartEpoch + (uint64_t)(micConsumed + micLost) * 1000000ULL / MIC_HZ;
    micConsumed += MIC_PER_PKT;
    micBuf[0] = 2;
    memcpy(micBuf + 3, &t0, 8);
    micBuf[11] = MIC_PER_PKT;
    sendPkt(micBuf, HDR + MIC_PER_PKT * 2);
    sent = true;
  }
  return sent;
}
#endif

// --------------------------------------------------------------------------
// control
// --------------------------------------------------------------------------
void startRec() {
  if (recording || !linkReady()) return;
  BLEConnection* c = Bluefruit.Connection(connHdl);
  if (c && c->getMtu() < 247) sendInfo(3, 0);   // MTU too small for 244-byte packets
#if MIC_ADPCM
  adPred = 0; adIdx = 0;
#endif
  seq = 0; imuN = 0; micWr = 0; micRd = 0; micLost = 0; micConsumed = 0;
  imuWr = 0; imuRd = 0; imuDropped = 0; pktSent = 0; pktDropped = 0;
  recStartEpoch = epochUs();
  micBaseSet  = false;
  micNeedBase = true;
  if (!micOk) sendInfo(1, 0);
  if (!imuOk) sendInfo(2, 0);
  if (micOk) {
    // 11 = sample rate + codec flag, 10 = rate only (older pages)
    sendInfo(11, ((uint64_t)MIC_ADPCM << 32) | (uint64_t)MIC_HZ);
    sendInfo(10, MIC_HZ);
  }
  imuSampling = imuOk;
  recording = true;                      // from here the PDM interrupt stores audio
  digitalWrite(LED_RED, LOW);            // red LED on (active low)
}

void stopRec() {
  if (!recording) return;
  imuSampling = false;
  recording = false;
  digitalWrite(LED_RED, HIGH);
}

// Runs in the SoftDevice event context: no FreeRTOS calls, no Serial, no
// blocking.  Just latch the request and a raw timer capture.
void ctrlWrite(uint16_t conn, BLECharacteristic* chr, uint8_t* data, uint16_t len) {
  (void)conn; (void)chr;
  if (len < 1) return;
  if (data[0] == 1) {
    pendingCmd = 1;
  } else if (data[0] == 2) {
    pendingCmd = 2;
  } else if (data[0] == 3 && len >= 9) {
    uint64_t e;
    memcpy(&e, data + 1, 8);
    pendingEpoch = e;
    NRF_TIMER4->TASKS_CAPTURE[2] = 1;    // timestamp now, apply later in loop()
    pendingRaw = NRF_TIMER4->CC[2];
    pendingTime = true;
  }
}

void onConnect(uint16_t h) {
  connHdl = h;
  Serial.println("BLE connected");
  BLEConnection* c = Bluefruit.Connection(h);
  c->requestPHY();                       // 2M PHY
  c->requestDataLengthUpdate();          // 251-byte LL payloads
  c->requestMtuExchange(BLE_MTU);        // 247-byte ATT MTU
  c->requestConnectionParameter(CONN_INTERVAL);
}

void onDisconnect(uint16_t h, uint8_t reason) {
  connHdl = BLE_CONN_HANDLE_INVALID;
  pendingCmd = 2;                        // stop recording when the link goes away
  Serial.print("BLE disconnected, reason 0x");
  Serial.println(reason, HEX);
}

// --------------------------------------------------------------------------
// keep the PDM clock on the crystal (see the note at the top of the file)
// --------------------------------------------------------------------------
void holdHfxo() {
  uint32_t running = 0;
  sd_clock_hfclk_request();
  for (int i = 0; i < 200; i++) {
    sd_clock_hfclk_is_running(&running);
    if (running) break;
    delay(1);
  }
  Serial.print("HFXO running: ");
  Serial.println(running ? "yes" : "NO");
}

// --------------------------------------------------------------------------
void setup() {
  Serial.begin(115200);
  pinMode(LED_RED, OUTPUT);
  digitalWrite(LED_RED, HIGH);
  clockStart();

  Bluefruit.configPrphConn(BLE_MTU, CONN_EVENT_LEN, 16, 4);
  Bluefruit.begin();
  Bluefruit.setTxPower(4);
  Bluefruit.setName("XIAO-Sense");
  Bluefruit.autoConnLed(false);
  Bluefruit.Periph.setConnInterval(CONN_INTERVAL, CONN_INTERVAL * 2);
  Bluefruit.Periph.setConnectCallback(onConnect);
  Bluefruit.Periph.setDisconnectCallback(onDisconnect);

  svc.begin();
  dataChr.setProperties(CHR_PROPS_NOTIFY);
  dataChr.setPermission(SECMODE_OPEN, SECMODE_NO_ACCESS);
  dataChr.setMaxLen(244);
  dataChr.begin();
  ctrlChr.setProperties(CHR_PROPS_WRITE | CHR_PROPS_WRITE_WO_RESP);
  ctrlChr.setPermission(SECMODE_NO_ACCESS, SECMODE_OPEN);
  ctrlChr.setMaxLen(16);
  ctrlChr.setWriteCallback(ctrlWrite);
  ctrlChr.begin();

  Bluefruit.Advertising.addFlags(BLE_GAP_ADV_FLAGS_LE_ONLY_GENERAL_DISC_MODE);
  Bluefruit.Advertising.addService(svc);
  Bluefruit.ScanResponse.addName();
  Bluefruit.Advertising.restartOnDisconnect(true);
  Bluefruit.Advertising.setInterval(32, 244);
  Bluefruit.Advertising.setFastTimeout(30);
  Bluefruit.Advertising.start(0);
  Serial.println("BLE started, advertising");

  delay(200);
  imuOk = imuInit();
  Serial.println(imuOk ? "IMU ok" : "IMU NOT FOUND");
  if (imuOk) xTaskCreate(imuTask, "imu", 1024, NULL, TASK_PRIO_NORMAL, NULL);

  // Must come before PDM.begin(): the PDM library only asks for the crystal
  // when it thinks it is not already running, and Bluefruit.begin() has just
  // started it for the radio.
  holdHfxo();

  // The mic runs continuously from boot, so recording starts with no
  // start-up transient and the first buffer is always valid.
  PDM.onReceive(onPDM);
  PDM.setBufferSize(PDM_BUF_BYTES);
  micOk = PDM.begin(1, MIC_HZ);
  PDM.setGain(MIC_GAIN);                 // begin() resets the gain to 20
  delay(100);                            // let the mic settle
  Serial.println(micOk ? "mic ok" : "MIC FAILED");
  Serial.print("mic rate target "); Serial.print(MIC_HZ);
  Serial.print(" Hz, gain "); Serial.println(MIC_GAIN);
  wdtStart();
}

// --------------------------------------------------------------------------
// diagnostics: proves whether the mic is really capturing 20 kHz
// --------------------------------------------------------------------------
void debugTick() {
  static uint32_t last = 0, lastMic = 0;
  if (millis() - last < 1000) return;
  uint32_t dt = millis() - last;
  last = millis();

  uint32_t mt = micTotal;
  uint32_t rate = (uint32_t)((uint64_t)(mt - lastMic) * 1000ULL / dt);
  lastMic = mt;

  // peak / rms of the newest 480 samples still in the ring
  int32_t  peak = 0;
  uint64_t ss   = 0;
  uint32_t w    = micWr;
  const uint32_t N = 480;
  if (w >= N) {
    for (uint32_t i = 0; i < N; i++) {
      int32_t v = micRing[(w - N + i) & (MIC_RING - 1)];
      int32_t a = v < 0 ? -v : v;
      if (a > peak) peak = a;
      ss += (uint64_t)(v * v);
    }
  }
  uint32_t rms = w >= N ? (uint32_t)sqrt((double)ss / N) : 0;

  Serial.print("rec=");      Serial.print(recording);
  Serial.print(" imuOk=");   Serial.print(imuOk);
  Serial.print(" micOk=");   Serial.print(micOk);
  Serial.print(" micHz=");   Serial.print(rate);
  Serial.print(" micRMS=");  Serial.print(rms);
  Serial.print(" micPeak="); Serial.print(peak);
  Serial.print(" sent=");    Serial.print(pktSent);
  Serial.print(" drop=");    Serial.print(pktDropped);
  Serial.print(" micLost="); Serial.print(micLost);
  Serial.print(" imuDrop="); Serial.print(imuDropped);
  BLEConnection* c = (connHdl != BLE_CONN_HANDLE_INVALID) ? Bluefruit.Connection(connHdl) : NULL;
  Serial.print(" mtu=");     Serial.println(c ? c->getMtu() : 0);
}

void loop() {
  wdtKick();
  debugTick();

  // apply a deferred wall-clock set (stamped in the BLE callback)
  if (pendingTime) {
    pendingTime = false;
    uint64_t now = micros64();
    uint32_t age = (uint32_t)now - pendingRaw;
    epochBase  = pendingEpoch;
    baseMicros = now - age;
  }

  uint8_t cmd = pendingCmd;
  if (cmd) {
    pendingCmd = 0;
    if (cmd == 1) startRec(); else stopRec();
  }

  if (recording) {
    bool a = imuPoll();                  // IMU first, so audio never starves it
    bool b = micPoll();
    if (!a && !b) delay(1);
  } else {
    delay(5);
  }
}
